## components/handler_ds18b20/Kconfig
```kconfig
menu Application
    config ONE_WIRE_ENABLED
        bool "One-Wire"
        help
            Select this option to enable One-Wire and show the submenu with One-Wire configuration choices.

    menu "One-Wire"
    	visible if ONE_WIRE_ENABLED
    
		config ONE_WIRE_GPIO
		    int "GPIO pin to use for One-wire interface"
		    default 18 
		    range 0 39
		    help
		        What GPIO pin should be used for One-wire interface.
	endmenu
endmenu
```

## components/handler_mqtt/Kconfig
```kconfig
menu "MQTT Broker Configuration"

    config MQTT_BROKER_URL
        string "MQTT Url incl. port number"
        default "mqtt://xxxxxxx:1883"
        help
            MQTT Url including port no to the MQTT broker to connect to.
            Format: url:portno

    config MQTT_BROKER_USERNAME
        string "Broker username"
        default "myusername"
        help
            Username for the MQTT Broker.

    config MQTT_BROKER_PASSWORD
        string "Broker password"
        default "mypassword"
        help
            Password for the MQTT Broker.        
endmenu
```

## components/handler_oled_128x64/Kconfig
```kconfig
menu OLED
    config DISPLAY_ENABLED
        bool "OLED Used"
        help
            Select this option to enable OLED Display and show the submenu with OLED configuration choices.
            
	menu "ESP Module"
    	visible if DISPLAY_ENABLED
    	
		choice
			prompt "Select ESP Module"
			default ESP32WROOM32C
			config OLIN128x64
					bool 
					prompt "Olin Oled 128 x 64"
						
			config ESP32WROOM32
				bool 
				prompt "ESP32-WROOM-32"
		endchoice
		
	    config MONO128x64_I2C_SDA_PIN
	        int
	        default 5 if OLIN128x64
	        default 21 if ESP32WROOM32
	        default -1
	        
	    config MONO128x64_I2C_SCL_PIN
	        int
	        default 4 if OLIN128x64
	        default 22 if ESP32WROOM32
	        default -1
	endmenu
endmenu
```
